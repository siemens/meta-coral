## conf/layer.conf
```bitbake
#
# Copyright (c) Siemens AG, 2022
#
# Authors:
#  Felix Moessbauer <felix.moessbauer@siemens.com>
#
# This file is subject to the terms and conditions of the MIT License.
# See COPYING.MIT file in the top-level directory.
#

BBPATH .= ":${LAYERDIR}"

BBFILES += "${LAYERDIR}/recipes-*/*/*.bb \
        ${LAYERDIR}/recipes-*/*/*.bbappend"

BBFILE_COLLECTIONS += "coral"
BBFILE_PATTERN_coral = "^${LAYERDIR}/recipes-*"
BBFILE_PRIORITY_coral = "6"

LAYERDIR_coral = "${LAYERDIR}"

LAYERSERIES_COMPAT_coral = "next"
```
